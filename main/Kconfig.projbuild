## main/Kconfig.projbuild
```kconfig
menu "*** FireLamp configuration ***"

	config FL_EFFECT_DEFAULT
		string "Default effect code"
		default "fire"
		help
			Code of the effect after first start or settings reset,
			e.g. fire, lamp, matrix, plasma_waves.
		
	config FL_FPS_DEFAULT
		int "Default FPS"
		range 1 100
		default 60

	config FL_BRIGHTNESS_DEFAULT
		int "Default brightness"
		range 1 255
		default 255

	config FL_BUILD_VARIANT
		string "Build variant name"
		default "default"
		help
			Name of this hardware configuration (buttons, RTC, EEPROM, LED type...).
			Official releases are built with the default configuration as
			variant "default". The internet update installs only a build of the
			same chip and variant, so a lamp built with its own configuration
			never gets a release made for different hardware. Use your own
			name (a-z, 0-9, '_') for a custom configuration.

	config FL_EFFECTS_BENCHMARK
		bool "Benchmark all effects at boot"
		default n
		help
			Before normal operation, run every effect for a number of frames
			and log the computation and output time per frame. Use it to
			check the CPU headroom on a particular chip (ESP32-C3 has no FPU
			and a single core).

	menu "Default WiFi configuration"

		choice FL_WIFI_MODE_C
			prompt "Default WiFi mode"
			default FL_WIFI_MODE_OFF
			help
				WiFi is optional: the lamp is controlled over BLE. WiFi settings
				are normally made from the phone app. The lamp only connects to a
				home network as a client (station).

			config FL_WIFI_MODE_OFF
				bool "Off"

			config FL_WIFI_MODE_PERIODIC
				bool "Periodic: connect every N hours for time sync, then disconnect"

			config FL_WIFI_MODE_ALWAYS_ON
				bool "Always on: stay connected, HTTP API available"
		endchoice

		config FL_WIFI_PERIOD
			int "Connection period for the periodic mode, hours"
			range 1 24
			default 1

		config FL_WIFI_SSID
			string "Network name (SSID)"
			default ""

		config FL_WIFI_PASSWORD
			string "Password"
			default ""

		config FL_WIFI_DHCP
			bool "Enable DHCP"
			default y

		config FL_WIFI_IP
			string "Static IP address (used when DHCP is off)"
			default "192.168.1.100"

		config FL_WIFI_NETMASK
			string "Netmask"
			default "255.255.255.0"

		config FL_WIFI_GATEWAY
			string "Gateway"
			default "192.168.1.1"

		config FL_WIFI_DNS
			string "DNS server"
			default "192.168.1.1"

		config FL_SNTP_SERVER
			string "SNTP server"
			default "pool.ntp.org"

		config FL_OTA_MANIFEST_URL
			string "Firmware update manifest URL"
			default "https://github.com/golyakoff/FireLamp_ESP32/releases/latest/download/manifest.json"
			help
				JSON manifest of the latest release, see main/updater.h.
				The lamp checks it on every WiFi session; updates are installed
				on request from the app only.

	endmenu

	menu "Hardware configuration"

		menu "LED matrix"

			config FL_MATRIX_WIDTH
				int "Matrix width, pixels"
				range 8 128
				default 16

			config FL_MATRIX_HEIGHT
				int "Matrix height, pixels"
				range 8 128
				default 16

			config FL_MATRIX_GPIO
				int "Matrix data GPIO"
				range 0 39 if IDF_TARGET_ESP32
				range 0 21 if IDF_TARGET_ESP32C3
				default 5

			choice FL_LED_BACKEND_C
				prompt "LED output peripheral"
				default FL_LED_BACKEND_SPI if IDF_TARGET_ESP32C3
				default FL_LED_BACKEND_RMT
				help
					SPI with DMA streams the whole frame without CPU help and is
					robust against interrupt latency (BLE/WiFi). It is the only
					reliable option on ESP32-C3, whose RMT has no DMA and tiny
					channel memory. RMT is fine on ESP32.

				config FL_LED_BACKEND_SPI
					bool "SPI (with DMA)"

				config FL_LED_BACKEND_RMT
					bool "RMT"
			endchoice

			choice FL_LED_TYPE_C
				prompt "Default LED type"
				default FL_LED_TYPE_WS2812

				config FL_LED_TYPE_WS2812
					bool "WS2812"

				config FL_LED_TYPE_SK6812
					bool "SK6812"

				config FL_LED_TYPE_WS2811
					bool "WS2811 (also APA106, SM16703)"
			endchoice

			choice FL_LED_COLOR_ORDER_C
				prompt "Default color order"
				default FL_LED_COLOR_ORDER_GRB

				config FL_LED_COLOR_ORDER_GRB
					bool "GRB (WS2812, SK6812)"

				config FL_LED_COLOR_ORDER_RGB
					bool "RGB (APA106, many WS2811)"
			endchoice

			config FL_SINGLE_LED_CURRENT_MA
				int "Maximal current consuming by single pixel, mA (see in datasheet)"
				default 33

			config FL_MATRIX_MAX_CURRENT
				int "Current limit of the whole lamp (power supply), mA"
				default 5000

			config FL_CONTROLLER_CURRENT_MA
				int "Current of the controller with WiFi and BLE (peaks), mA"
				default 300
				help
					Subtracted from the current limit before the LEDs get the rest.

			config FL_LED_IDLE_CURRENT_UA
				int "Current of an unlit pixel, uA"
				default 1000
				help
					WS2812 and the like take about 1 mA even when black; subtracted from the
					current limit for every pixel.

			choice FL_MATRIX_ROTATION_C
				prompt "Default surface rotation"
				default FL_MATRIX_ROTATION_0

				config FL_MATRIX_ROTATION_0
					bool "No rotation"

				config FL_MATRIX_ROTATION_90
					bool "90 degrees"

				config FL_MATRIX_ROTATION_180
					bool "180 degrees"

				config FL_MATRIX_ROTATION_270
					bool "270 degrees"
			endchoice

			config FL_MATRIX_MIRROR
				bool "Mirror surface horizontally by default"
				default n

		endmenu

		menu "Controls"

			choice FL_INPUT_MODE_C
				prompt "Default control elements"
				default FL_INPUT_ONE_BUTTON
				help
					Only the default: the control elements are a setting that can be
					changed from the app (Hardware settings). The pins of all buttons
					are fixed below.

					One button (or touch pad):
					  lamp off: click - turn on, hold 10 s - reset all settings;
					  lamp on: click - next effect, double click - turn off,
					  triple click - previous effect, hold - change brightness
					  (direction alternates with every hold);
					  5 clicks - BLE pairing window.
					Four buttons (as in EvLamp):
					  Main: click - next effect, hold - turn on/off, 5 clicks - pairing;
					  Up/Down: brightness, hold to repeat;
					  Reset: hold 3 s - reset all settings.

				config FL_INPUT_ONE_BUTTON
					bool "One button (or TTP223 touch module)"

				config FL_INPUT_FOUR_BUTTONS
					bool "Four buttons: Main, Up, Down, Reset"

				config FL_INPUT_TOUCH
					bool "ESP32 built-in touch pad"
					depends on IDF_TARGET_ESP32
			endchoice

			config FL_BUTTON_LEVEL
				int "Default logic level of Main/Up/Down buttons for 'pressed' state"
				range 0 1
				default 1
				help
					Only the default, it is a setting in the app (Hardware settings).
					1 - TTP223 touch module (active high) or a button to +3.3V,
					0 - a button to GND. The internal pull resistor is always enabled
					towards the opposite level.

			config FL_BUTTON_MAIN_GPIO
				int "'Main' button GPIO pin"
				range 0 39 if IDF_TARGET_ESP32
				range 0 21 if IDF_TARGET_ESP32C3
				default 4 if IDF_TARGET_ESP32C3
				default 25

			config FL_BUTTON_UP_GPIO
				int "'Up' button GPIO pin (four buttons)"
				range 0 39 if IDF_TARGET_ESP32
				range 0 21 if IDF_TARGET_ESP32C3
				default 6 if IDF_TARGET_ESP32C3
				default 26

			config FL_BUTTON_DOWN_GPIO
				int "'Down' button GPIO pin (four buttons)"
				range 0 39 if IDF_TARGET_ESP32
				range 0 21 if IDF_TARGET_ESP32C3
				default 7 if IDF_TARGET_ESP32C3
				default 27

			config FL_BUTTON_RESET_GPIO
				int "'Reset' button GPIO pin (four buttons)"
				range 0 39 if IDF_TARGET_ESP32
				range 0 21 if IDF_TARGET_ESP32C3
				default 9 if IDF_TARGET_ESP32C3
				default 0

			config FL_BUTTON_RESET_LEVEL
				int "Logic level of reset button for 'pressed' state (BOOT button: 0)"
				range 0 1
				default 0

			config FL_TOUCH_CHANNEL
				int "Touch pad channel"
				depends on IDF_TARGET_ESP32
				range 0 9
				default 0
				help
					Touch channel and its GPIO:
					T0 - GPIO4, T1 - GPIO0, T2 - GPIO2, T3 - GPIO15, T4 - GPIO13,
					T5 - GPIO12, T6 - GPIO14, T7 - GPIO27, T8 - GPIO33, T9 - GPIO32.
					Avoid T1 (GPIO0), T2 (GPIO2) and T5 (GPIO12): strapping pins.

			config FL_TOUCH_THRESHOLD_PERCENT
				int "Touch threshold, % of the untouched value"
				depends on IDF_TARGET_ESP32
				range 1 50
				default 3
				help
					The pad counts as touched when its value drops by this percentage
					below the untouched value measured at boot (and slowly tracked
					afterwards). Increase if the pad triggers by itself, decrease if it
					does not react through the lamp body.

		endmenu

		menu "I2C bus (DS3231 RTC, AT24Cxx EEPROM)"

			config FL_I2C_SDA_GPIO
				int "SDA GPIO"
				range 0 39 if IDF_TARGET_ESP32
				range 0 21 if IDF_TARGET_ESP32C3
				default 3 if IDF_TARGET_ESP32C3
				default 21

			config FL_I2C_SCL_GPIO
				int "SCL GPIO"
				range 0 39 if IDF_TARGET_ESP32
				range 0 21 if IDF_TARGET_ESP32C3
				default 10 if IDF_TARGET_ESP32C3
				default 22

			config FL_I2C_FREQ_HZ
				int "Bus frequency, Hz"
				range 10000 1000000
				default 400000

			config FL_I2C_INTERNAL_PULLUP
				bool "Enable internal pullups"
				default y
				help
					Keeps the bus lines defined when nothing is connected, so probing
					an empty bus at boot is quick. Modules usually have their own
					4.7 kOhm pullups as well.

			config FL_EEPROM_ADDR
				hex "EEPROM I2C address"
				range 0x50 0x57
				default 0x50
				help
					An AT24C32..AT24C512 EEPROM found at this address at boot keeps the
					settings instead of the internal flash. 0x50..0x57 depending on
					A0..A2 pins. Note: the AT24C32 on common DS3231 modules is usually
					at 0x57.

		endmenu

		menu "Time"

			config FL_TZ_DEFAULT
				string "Default time zone (POSIX TZ string)"
				default "MSK-3"
				help
					Examples: "MSK-3" (Moscow), "EET-2EEST,M3.5.0/3,M10.5.0/4" (Kyiv),
					"CET-1CEST,M3.5.0,M10.5.0/3" (Berlin), "UTC0".
					Can be changed at runtime.

		endmenu



	endmenu

endmenu
```
